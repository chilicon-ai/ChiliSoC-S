## sw/zephyr/boards/chilicon/chilisocs_sim/Kconfig.chilisocs_sim
```kconfig
# SPDX-License-Identifier: Apache-2.0
# Copyright 2026 Chilicon
config BOARD_CHILISOCS_SIM
	select SOC_CHILISOCS
```

## sw/zephyr/boards/chilicon/chilisocs_sim/board.yml
```yaml
# SPDX-License-Identifier: Apache-2.0
# Copyright 2026 Chilicon
board:
  name: chilisocs_sim
  full_name: ChiliSoC-S simulation
  vendor: chilicon
  socs:
    - name: chilisocs
```
